## arch/arm64/configs/s20p_defconfig
```kconfig
#
# Galaxy S20 Plus
#
CONFIG_KEYBOARD_STM_FSR=y
CONFIG_SENSOR_RETENTION_USE=y
# CONFIG_CAMERA_HST_V01 is not set
CONFIG_CAMERA_HST_V02=y
# CONFIG_CAMERA_HST_V03 is not set
CONFIG_CAMERA_CIS_TOF_BUCK_USE=y
CONFIG_CAMERA_CIS_3J1_OBJ=y
# CONFIG_CAMERA_CIS_GH1_OBJ is not set
CONFIG_CAMERA_CIS_GW2_OBJ=y
# CONFIG_CAMERA_CIS_2L3_OBJ is not set
CONFIG_CAMERA_CIS_2LA_OBJ=y
CONFIG_CAMERA_CIS_2LD_OBJ=y
# CONFIG_CAMERA_CIS_HM1_OBJ is not set
CONFIG_CAMERA_CIS_IMX516_OBJ=y
CONFIG_CAMERA_CIS_IMX518_OBJ=y
# CONFIG_CAMERA_CIS_IMX586_OBJ is not set
# CONFIG_WIRELESS_CHARGER_MFC_S2MIW04 is not set
# CONFIG_WIRELESS_CHARGER_HAL_MFC is not set
# CONFIG_SENSORS_A96T3X6 is not set
# CONFIG_SENSORS_FW_VENDOR is not set
# CONFIG_SENSORS_A96T365IF is not set
# CONFIG_SENSORS_A96T3X6_CRC_CHECK is not set
# CONFIG_SENSORS_A96T3X6_BLOCK_SAR_ONLY is not set
```
